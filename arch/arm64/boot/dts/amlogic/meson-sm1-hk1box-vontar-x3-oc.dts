// SPDX-License-Identifier: (GPL-2.0+ OR MIT)
/*
 * Author: flippy <flippy@sina.com>
 */

/dts-v1/;

#include "meson-sm1-hk1box-vontar-x3.dts"

/ {
	model = "HK1 Box/Vontar X3 @ 2184Mhz";
};

&cpu_opp_table {

	opp-2184000000 {
		opp-hz = /bits/ 64 <2184000000>;
		opp-microvolt = <1022000>;
	};
};

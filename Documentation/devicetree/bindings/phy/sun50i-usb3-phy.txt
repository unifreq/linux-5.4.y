## Documentation/devicetree/bindings/phy/sun50i-usb3-phy.txt
```
Allwinner sun50i USB3 PHY
-----------------------

Required properties:
- compatible : should be one of
  * allwinner,sun60i-h6-usb3-phy
- reg : a list of offset + length pairs
- #phy-cells : from the generic phy bindings, must be 0
- clocks : phandle + clock specifier for the phy clock
- resets : phandle + reset specifier for the phy reset

Optional nodes:
- connector : A sub-node required for representing the connector connected
	      to the USB PHY. See ../connector/usb-connector.txt for details.

Example:
	usb3phy: phy@5210000 {
		compatible = "allwinner,sun50i-h6-usb3-phy";
		reg = <0x5210000 0x10000>;
		clocks = <&ccu CLK_USB_PHY1>;
		resets = <&ccu RST_USB_PHY1>;
		#phy-cells = <0>;

		connector {
			compatible = "usb-a-connector";
			label = "USB3";
		};
	};
```

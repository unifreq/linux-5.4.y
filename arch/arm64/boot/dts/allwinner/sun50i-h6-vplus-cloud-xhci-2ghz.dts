// SPDX-License-Identifier: (GPL-2.0+ OR MIT)
// Copyright (C) 2019 Ondřej Jirman <megous@megous.com>

/dts-v1/;

#include "sun50i-h6-vplus-cloud-xhci.dts"
#include "sun50i-h6-vplus-cloud-cpu-opp-addon.dtsi"

/ {
	model = "V-Plus Cloud @ 2GHz";
};
